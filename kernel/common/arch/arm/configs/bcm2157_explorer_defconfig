## kernel/common/arch/arm/mach-bcm215xx/Kconfig
```kconfig
menu "Broadcom BCM215XX Implementations"
	depends on ARCH_BCM215XX

comment "BCM215XX Core Type"

choice
	prompt "Silicon version selection in BCM21553 family of devices"
	depends on ARCH_BCM215XX
	default ARCH_BCM21553_A0

config ARCH_BCM21553_A0
	bool "BCM21553 A0 based system"

config ARCH_BCM21553_B0
	bool "BCM21553 B0 based system"

endchoice

comment "BCM21553 Board Type"

choice
       prompt "Board selection in BCM21553 family of devices"
       depends on ARCH_BCM21553_A0 || ARCH_BCM21553_B0
       default BOARD_ATHENARAY

config BOARD_ATHENARAY
	bool "Broadcom BCM21553 AthenaRay EDN10 development board"
	help
	  Configure this option to specify the whether the board used
	  for development is a BCM21553 EDN10 AthenaRay.

config BOARD_ATHENARAY_EDN20
	bool "Broadcom BCM21553 AthenaRay EDN20 development board"
	help
	  Configure this option to specify the whether the board used
	  for development is a BCM21553 EDN20 AthenaRay.

config BOARD_THUNDERBIRD
	bool "Broadcom BCM21553 Thunderbird board"
	help
	  Configure this option to specify the whether the used
	  for development is a BCM21553 Thunderbird.

config BOARD_THUNDERBIRD_EDN31
	bool "Broadcom BCM21553 Thunderbird EDN31 board"
	help
	  Configure this option to specify the whether the used
	  for development is a BCM21553 Thunderbird EDN31.

endchoice

config SDRAM_BASE_ADDR
hex "SDRAM Base address"
depends on ARCH_BCM215XX

config BCM215XX_PM
        bool "Enable Platform power management for BCM215XX platform"
        depends on PM && ARCH_BCM215XX
        help
          Say Yes here to enable platform power management for BCM215XX platform

endmenu
```

## kernel/common/arch/arm/plat-bcmap/Kconfig
```kconfig
if PLAT_BCMAP

choice
	prompt "Broadcom Application Processor Family"
	default ARCH_BCM116X

config ARCH_BCM116X
	select CPU_V6
	select HAVE_CLK
	select COMMON_CLKDEV
        bool "Broadcom BCM116X Family"
	help
	  Support for Broadcom 116X based systems. This runs on the ARM11
	  apps processor of the 116X and depends on a shared memory
	  interface to the ARM9 modem processor which runs the baseband
	  stack and controls some vital subsystems.

endchoice

config BCM_PWM_CORE
	bool "Broadcom PWM Core"
	help
	  Enable Broadcom PWM core layer. This option is required for PWM device
	  drivers and backlight drivers.
endif
```

## kernel/common/drivers/net/wireless/4319/Kconfig
```kconfig
config BCM_4319_DRIVER
	bool "BCM_4319_DRIVER"
	depends on MMC
	---help---
	  This module adds support for wireless adapters based on
	  BCM4319 chipset.
	  If you choose to build a module, it'll be called bcm4319. Say M if
	  unsure.
```

## kernel/common/drivers/video/broadcom/Kconfig
```kconfig
config FB_BCM_116X
        tristate "BCM 116X platform framebuffer support"
        depends on FB_BCM && ARCH_BCM116X
        default n

config ENABLE_FPS
        tristate "FPS readout support"
        depends on FB_BCM
        default n

source "drivers/video/broadcom/dss/Kconfig"
source "drivers/video/broadcom/displays/Kconfig"
source "drivers/video/broadcom/hantro/memalloc_wrapper/Kconfig"
source "drivers/video/broadcom/ge/gememalloc_wrapper/Kconfig"
```

## kernel/common/drivers/video/broadcom/displays/Kconfig
```kconfig
menu "Broadcom Display Device Drivers"

config PANEL_MAGNA_D51E5TA7601
        tristate "Magna TrulyHVGA LCD Panel with D51E5TA7601 controller"
        default N
        help
          Magna TrulyHVGA LCD Panel with D51E5TA7601 controller

config BCM_LCD_NT35582
        tristate "LCD Panel- N35582 controller"
        default N
        help
	  WVGA LCD panel (N35582 controller)

config BCM_LCD_BTG222432
        tristate "HYUNDAI BTG222432 LCD support"
        depends on MACH_MARTINI || BOARD_BONDRAY || BOARD_EXPLORER
        ---help---
         Support for HYUNDAI BTG222432 LCD
         Say Y here to enable HYUNDAI BTG222432 LCD driver
         Say m to make it a loadable module

config BCM_LCD_HX8352_DF2440V8
    tristate "Wintek HX8352 DF2440V8 LCD support"
    depends on BOARD_BRAVA || BOARD_BRAVA_EDN10
    ---help---
     Support for WINTEK HX8352 DF2440V8 LCD Driver
     Say Y here to enable Wintek HX8352 DF2440V8 LCD driver
     Say m to make it a loadable module

config BCM_LCD_HX8347_TFT1P5158
    tristate "Truely HX8347 TFT1P5158 LCD support"
     default n
    ---help---
     Support for Truely HX8347 TFT1P5158 LCD Driver
     Say Y here to enable Truely HX8347 TFT1P5158 LCD driver
     Say m to make it a loadable module

config BCM_LCD_SKIP_INIT
    bool "Skip LCD controller and panel initialization"
     default n
    ---help---
     Support for skipping LCD controller and panel initialization.
     Say Y here if bootloader does the job of initialization


config BCM_LCD_TE_ENABLE
    tristate "BRCM LCD TE support"
     default n
    ---help---
     Support for Tearing Effect in BRCM LCD Driver
     Say Y here to enable Tearing Effect in BRCM LCD driver
     Say m to make it a loadable module
endmenu
```

## kernel/common/drivers/video/broadcom/dss/Kconfig
```kconfig
menuconfig BCM_DSS
        bool "Broadcom Display Subsystem support (EXPERIMENTAL)"
	default N
        help
          Broadcom Display Subsystem support.
```
